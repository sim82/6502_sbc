; sawtooth slope as 8.8bit unsigned fixpoint values
; sample rate: 10000
SCALE_LEN = 60
scale_l:
.byte $10	; 27.5Hz, 16 = $0010
.byte $11	; 29.13523509488062Hz, 17 = $0011
.byte $12	; 30.86770632850775Hz, 18 = $0012
.byte $13	; 32.70319566257483Hz, 19 = $0013
.byte $14	; 34.64782887210901Hz, 20 = $0014
.byte $15	; 36.70809598967594Hz, 21 = $0015
.byte $17	; 38.890872965260115Hz, 23 = $0017
.byte $18	; 41.20344461410875Hz, 24 = $0018
.byte $19	; 43.653528929125486Hz, 25 = $0019
.byte $1b	; 46.2493028389543Hz, 27 = $001b
.byte $1d	; 48.999429497718666Hz, 29 = $001d
.byte $1e	; 51.91308719749314Hz, 30 = $001e
.byte $20	; 55Hz, 32 = $0020
.byte $22	; 58.27047018976124Hz, 34 = $0022
.byte $24	; 61.7354126570155Hz, 36 = $0024
.byte $26	; 65.40639132514966Hz, 38 = $0026
.byte $28	; 69.29565774421802Hz, 40 = $0028
.byte $2b	; 73.41619197935188Hz, 43 = $002b
.byte $2d	; 77.78174593052023Hz, 45 = $002d
.byte $30	; 82.4068892282175Hz, 48 = $0030
.byte $33	; 87.30705785825097Hz, 51 = $0033
.byte $36	; 92.4986056779086Hz, 54 = $0036
.byte $39	; 97.99885899543733Hz, 57 = $0039
.byte $3c	; 103.82617439498628Hz, 60 = $003c
.byte $40	; 110Hz, 64 = $0040
.byte $44	; 116.54094037952248Hz, 68 = $0044
.byte $48	; 123.47082531403103Hz, 72 = $0048
.byte $4c	; 130.8127826502993Hz, 76 = $004c
.byte $51	; 138.59131548843604Hz, 81 = $0051
.byte $55	; 146.8323839587038Hz, 85 = $0055
.byte $5b	; 155.56349186104046Hz, 91 = $005b
.byte $60	; 164.81377845643496Hz, 96 = $0060
.byte $66	; 174.61411571650194Hz, 102 = $0066
.byte $6c	; 184.9972113558172Hz, 108 = $006c
.byte $72	; 195.99771799087463Hz, 114 = $0072
.byte $79	; 207.65234878997256Hz, 121 = $0079
.byte $80	; 220Hz, 128 = $0080
.byte $88	; 233.08188075904496Hz, 136 = $0088
.byte $90	; 246.94165062806206Hz, 144 = $0090
.byte $98	; 261.6255653005986Hz, 152 = $0098
.byte $a1	; 277.1826309768721Hz, 161 = $00a1
.byte $ab	; 293.6647679174076Hz, 171 = $00ab
.byte $b5	; 311.1269837220809Hz, 181 = $00b5
.byte $c0	; 329.6275569128699Hz, 192 = $00c0
.byte $cb	; 349.2282314330039Hz, 203 = $00cb
.byte $d7	; 369.9944227116344Hz, 215 = $00d7
.byte $e4	; 391.99543598174927Hz, 228 = $00e4
.byte $f2	; 415.3046975799451Hz, 242 = $00f2
.byte $00	; 440Hz, 256 = $0100
.byte $0f	; 466.1637615180899Hz, 271 = $010f
.byte $1f	; 493.8833012561241Hz, 287 = $011f
.byte $30	; 523.2511306011972Hz, 304 = $0130
.byte $43	; 554.3652619537442Hz, 323 = $0143
.byte $56	; 587.3295358348151Hz, 342 = $0156
.byte $6a	; 622.2539674441618Hz, 362 = $016a
.byte $80	; 659.2551138257398Hz, 384 = $0180
.byte $96	; 698.4564628660078Hz, 406 = $0196
.byte $af	; 739.9888454232688Hz, 431 = $01af
.byte $c8	; 783.9908719634985Hz, 456 = $01c8
.byte $e3	; 830.6093951598903Hz, 483 = $01e3

scale_h:
.byte $00	; 27.5Hz, 16 = $0010
.byte $00	; 29.13523509488062Hz, 17 = $0011
.byte $00	; 30.86770632850775Hz, 18 = $0012
.byte $00	; 32.70319566257483Hz, 19 = $0013
.byte $00	; 34.64782887210901Hz, 20 = $0014
.byte $00	; 36.70809598967594Hz, 21 = $0015
.byte $00	; 38.890872965260115Hz, 23 = $0017
.byte $00	; 41.20344461410875Hz, 24 = $0018
.byte $00	; 43.653528929125486Hz, 25 = $0019
.byte $00	; 46.2493028389543Hz, 27 = $001b
.byte $00	; 48.999429497718666Hz, 29 = $001d
.byte $00	; 51.91308719749314Hz, 30 = $001e
.byte $00	; 55Hz, 32 = $0020
.byte $00	; 58.27047018976124Hz, 34 = $0022
.byte $00	; 61.7354126570155Hz, 36 = $0024
.byte $00	; 65.40639132514966Hz, 38 = $0026
.byte $00	; 69.29565774421802Hz, 40 = $0028
.byte $00	; 73.41619197935188Hz, 43 = $002b
.byte $00	; 77.78174593052023Hz, 45 = $002d
.byte $00	; 82.4068892282175Hz, 48 = $0030
.byte $00	; 87.30705785825097Hz, 51 = $0033
.byte $00	; 92.4986056779086Hz, 54 = $0036
.byte $00	; 97.99885899543733Hz, 57 = $0039
.byte $00	; 103.82617439498628Hz, 60 = $003c
.byte $00	; 110Hz, 64 = $0040
.byte $00	; 116.54094037952248Hz, 68 = $0044
.byte $00	; 123.47082531403103Hz, 72 = $0048
.byte $00	; 130.8127826502993Hz, 76 = $004c
.byte $00	; 138.59131548843604Hz, 81 = $0051
.byte $00	; 146.8323839587038Hz, 85 = $0055
.byte $00	; 155.56349186104046Hz, 91 = $005b
.byte $00	; 164.81377845643496Hz, 96 = $0060
.byte $00	; 174.61411571650194Hz, 102 = $0066
.byte $00	; 184.9972113558172Hz, 108 = $006c
.byte $00	; 195.99771799087463Hz, 114 = $0072
.byte $00	; 207.65234878997256Hz, 121 = $0079
.byte $00	; 220Hz, 128 = $0080
.byte $00	; 233.08188075904496Hz, 136 = $0088
.byte $00	; 246.94165062806206Hz, 144 = $0090
.byte $00	; 261.6255653005986Hz, 152 = $0098
.byte $00	; 277.1826309768721Hz, 161 = $00a1
.byte $00	; 293.6647679174076Hz, 171 = $00ab
.byte $00	; 311.1269837220809Hz, 181 = $00b5
.byte $00	; 329.6275569128699Hz, 192 = $00c0
.byte $00	; 349.2282314330039Hz, 203 = $00cb
.byte $00	; 369.9944227116344Hz, 215 = $00d7
.byte $00	; 391.99543598174927Hz, 228 = $00e4
.byte $00	; 415.3046975799451Hz, 242 = $00f2
.byte $01	; 440Hz, 256 = $0100
.byte $01	; 466.1637615180899Hz, 271 = $010f
.byte $01	; 493.8833012561241Hz, 287 = $011f
.byte $01	; 523.2511306011972Hz, 304 = $0130
.byte $01	; 554.3652619537442Hz, 323 = $0143
.byte $01	; 587.3295358348151Hz, 342 = $0156
.byte $01	; 622.2539674441618Hz, 362 = $016a
.byte $01	; 659.2551138257398Hz, 384 = $0180
.byte $01	; 698.4564628660078Hz, 406 = $0196
.byte $01	; 739.9888454232688Hz, 431 = $01af
.byte $01	; 783.9908719634985Hz, 456 = $01c8
.byte $01	; 830.6093951598903Hz, 483 = $01e3
