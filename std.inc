
NUM1 = $0000
ARG0 = $0000
ARG0L = $0000
ARG0H = $0001
NUM2 = $0002
ARG1 = $0002
ARG1L = $0002
ARG1H = $0003
REM = $0004
DISP_POSX = $0006
DISP_POSY = $0007
IRQ_TMP_A = $0008
TARGET_ADDR = $09 ; must be the last global ZP entry! dos starts after this!

IO_BASE = $fe00

IO_GPIO0        = IO_BASE + $00
IO_GPIO10        = IO_BASE + $80
IO_GPIO11        = IO_BASE + $90


IO_DISP_CTRL    = IO_BASE + $10
IO_DISP_DATA    = IO_BASE + $11

IO_IDE_BASE     = IO_BASE + $20
IO_IDE_DATA_LOW = IO_IDE_BASE + $0
IO_IDE_DATA_HIGH= IO_IDE_BASE + $8
IO_IDE_ERROR    = IO_IDE_BASE + $1
IO_IDE_SIZE     = IO_IDE_BASE + $2
IO_IDE_LBA_LOW  = IO_IDE_BASE + $3
IO_IDE_LBA_MID  = IO_IDE_BASE + $4
IO_IDE_LBA_HIGH = IO_IDE_BASE + $5
IO_IDE_DRIVE_HEAD = IO_IDE_BASE + $6
IO_IDE_CMD      = IO_IDE_BASE + $7
IO_IDE_STATUS    = IO_IDE_BASE + $7 

IDE_CMD_READ    = $20
IDE_CMD_WRITE   = $30


IO_UART_BASE    = IO_BASE + $30
IO_UART_IER1    = IO_UART_BASE + $0
IO_UART_ISR1    = IO_UART_BASE + $0
IO_UART_CR1     = IO_UART_BASE + $1
IO_UART_FR1     = IO_UART_BASE + $1
IO_UART_CSR1    = IO_UART_BASE + $1
IO_UART_ACR1    = IO_UART_BASE + $2
IO_UART_TDR1    = IO_UART_BASE + $3
IO_UART_CDR1    = IO_UART_BASE + $2
IO_UART_RDR1    = IO_UART_BASE + $3
IO_UART_IER2    = IO_UART_BASE + $4
IO_UART_ISR2    = IO_UART_BASE + $4
IO_UART_CR2     = IO_UART_BASE + $5
IO_UART_FR2     = IO_UART_BASE + $5
IO_UART_CSR2    = IO_UART_BASE + $5
IO_UART_CDR2    = IO_UART_BASE + $6
IO_UART_ACR2    = IO_UART_BASE + $6
IO_UART_TDR2    = IO_UART_BASE + $7
IO_UART_RDR2    = IO_UART_BASE + $7

IO_UART2_BASE   = IO_BASE + $40
IO_UART2_MRA    = IO_UART2_BASE + $0
IO_UART2_CSRA   = IO_UART2_BASE + $1
IO_UART2_SRA    = IO_UART2_BASE + $1
IO_UART2_CRA    = IO_UART2_BASE + $2
IO_UART2_FIFOA  = IO_UART2_BASE + $3
IO_UART2_ACR    = IO_UART2_BASE + $4
IO_UART2_ISR    = IO_UART2_BASE + $5
IO_UART2_IMR    = IO_UART2_BASE + $5
IO_UART2_CTPU   = IO_UART2_BASE + $6
IO_UART2_CTPL   = IO_UART2_BASE + $7
IO_UART2_MRB    = IO_UART2_BASE + $8
IO_UART2_CSRB   = IO_UART2_BASE + $9
IO_UART2_SRB    = IO_UART2_BASE + $9
IO_UART2_CRB    = IO_UART2_BASE + $a
IO_UART2_FIFOB  = IO_UART2_BASE + $b
IO_UART2_GPR    = IO_UART2_BASE + $c
IO_UART2_SOPR   = IO_UART2_BASE + $e
IO_UART2_ROPR   = IO_UART2_BASE + $f
IO_UART2_CSTA   = IO_UART2_BASE + $e
IO_UART2_CSTO   = IO_UART2_BASE + $f

; GPIO bank 2 shares IO-enable pin 2 with UART2 (in its unused ADDR04 HIGH area. 
; Requires JP2 in 'or' position and U13 or-gate populated, otherwise chaos will break lose)
IO_GPIO2X        = IO_BASE + $50
IO_GPIO20        = IO_GPIO2X + $0
IO_GPIO21        = IO_GPIO2X + $1

IO_UARTAUX_BASE   = IO_BASE + $40
IO_UARTAUX_MRA    = IO_UARTAUX_BASE + $0
IO_UARTAUX_CSRA   = IO_UARTAUX_BASE + $1
IO_UARTAUX_SRA    = IO_UARTAUX_BASE + $1
IO_UARTAUX_CRA    = IO_UARTAUX_BASE + $2
IO_UARTAUX_FIFOA  = IO_UARTAUX_BASE + $3
IO_UARTAUX_ACR    = IO_UARTAUX_BASE + $4
IO_UARTAUX_ISR    = IO_UARTAUX_BASE + $5
IO_UARTAUX_IMR    = IO_UARTAUX_BASE + $5
IO_UARTAUX_CTPU   = IO_UARTAUX_BASE + $6
IO_UARTAUX_CTPL   = IO_UARTAUX_BASE + $7
IO_UARTAUX_MRB    = IO_UARTAUX_BASE + $8
IO_UARTAUX_CSRB   = IO_UARTAUX_BASE + $9
IO_UARTAUX_SRB    = IO_UARTAUX_BASE + $9
IO_UARTAUX_CRB    = IO_UARTAUX_BASE + $a
IO_UARTAUX_FIFOB  = IO_UARTAUX_BASE + $b
IO_UARTAUX_SOPR   = IO_UARTAUX_BASE + $e
IO_UARTAUX_ROPR   = IO_UARTAUX_BASE + $f
IO_UARTAUX_CSTA   = IO_UARTAUX_BASE + $e
IO_UARTAUX_CSTO   = IO_UARTAUX_BASE + $f

