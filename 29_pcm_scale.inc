; sawtooth slope as 8.8bit unsigned fixpoint values
; sample rate: 10000
SCALE_LEN = 60
scale_l:
.byte $b4	; 27.5Hz, 180 = $00b4
.byte $bf	; 29.13523509488062Hz, 191 = $00bf
.byte $ca	; 30.86770632850775Hz, 202 = $00ca
.byte $d6	; 32.70319566257483Hz, 214 = $00d6
.byte $e3	; 34.64782887210901Hz, 227 = $00e3
.byte $f1	; 36.70809598967594Hz, 241 = $00f1
.byte $ff	; 38.890872965260115Hz, 255 = $00ff
.byte $0e	; 41.20344461410875Hz, 270 = $010e
.byte $1e	; 43.653528929125486Hz, 286 = $011e
.byte $2f	; 46.2493028389543Hz, 303 = $012f
.byte $41	; 48.999429497718666Hz, 321 = $0141
.byte $54	; 51.91308719749314Hz, 340 = $0154
.byte $68	; 55Hz, 360 = $0168
.byte $7e	; 58.27047018976124Hz, 382 = $017e
.byte $95	; 61.7354126570155Hz, 405 = $0195
.byte $ad	; 65.40639132514966Hz, 429 = $01ad
.byte $c6	; 69.29565774421802Hz, 454 = $01c6
.byte $e1	; 73.41619197935188Hz, 481 = $01e1
.byte $fe	; 77.78174593052023Hz, 510 = $01fe
.byte $1c	; 82.4068892282175Hz, 540 = $021c
.byte $3c	; 87.30705785825097Hz, 572 = $023c
.byte $5e	; 92.4986056779086Hz, 606 = $025e
.byte $82	; 97.99885899543733Hz, 642 = $0282
.byte $a8	; 103.82617439498628Hz, 680 = $02a8
.byte $d1	; 110Hz, 721 = $02d1
.byte $fc	; 116.54094037952248Hz, 764 = $02fc
.byte $29	; 123.47082531403103Hz, 809 = $0329
.byte $59	; 130.8127826502993Hz, 857 = $0359
.byte $8c	; 138.59131548843604Hz, 908 = $038c
.byte $c2	; 146.8323839587038Hz, 962 = $03c2
.byte $fc	; 155.56349186104046Hz, 1020 = $03fc
.byte $38	; 164.81377845643496Hz, 1080 = $0438
.byte $78	; 174.61411571650194Hz, 1144 = $0478
.byte $bc	; 184.9972113558172Hz, 1212 = $04bc
.byte $04	; 195.99771799087463Hz, 1284 = $0504
.byte $51	; 207.65234878997256Hz, 1361 = $0551
.byte $a2	; 220Hz, 1442 = $05a2
.byte $f8	; 233.08188075904496Hz, 1528 = $05f8
.byte $52	; 246.94165062806206Hz, 1618 = $0652
.byte $b3	; 261.6255653005986Hz, 1715 = $06b3
.byte $19	; 277.1826309768721Hz, 1817 = $0719
.byte $85	; 293.6647679174076Hz, 1925 = $0785
.byte $f7	; 311.1269837220809Hz, 2039 = $07f7
.byte $70	; 329.6275569128699Hz, 2160 = $0870
.byte $f1	; 349.2282314330039Hz, 2289 = $08f1
.byte $79	; 369.9944227116344Hz, 2425 = $0979
.byte $09	; 391.99543598174927Hz, 2569 = $0a09
.byte $a2	; 415.3046975799451Hz, 2722 = $0aa2
.byte $44	; 440Hz, 2884 = $0b44
.byte $ef	; 466.1637615180899Hz, 3055 = $0bef
.byte $a5	; 493.8833012561241Hz, 3237 = $0ca5
.byte $65	; 523.2511306011972Hz, 3429 = $0d65
.byte $31	; 554.3652619537442Hz, 3633 = $0e31
.byte $09	; 587.3295358348151Hz, 3849 = $0f09
.byte $ee	; 622.2539674441618Hz, 4078 = $0fee
.byte $e0	; 659.2551138257398Hz, 4320 = $10e0
.byte $e1	; 698.4564628660078Hz, 4577 = $11e1
.byte $f2	; 739.9888454232688Hz, 4850 = $12f2
.byte $12	; 783.9908719634985Hz, 5138 = $1412
.byte $43	; 830.6093951598903Hz, 5443 = $1543

scale_h:
.byte $00	; 27.5Hz, 180 = $00b4
.byte $00	; 29.13523509488062Hz, 191 = $00bf
.byte $00	; 30.86770632850775Hz, 202 = $00ca
.byte $00	; 32.70319566257483Hz, 214 = $00d6
.byte $00	; 34.64782887210901Hz, 227 = $00e3
.byte $00	; 36.70809598967594Hz, 241 = $00f1
.byte $00	; 38.890872965260115Hz, 255 = $00ff
.byte $01	; 41.20344461410875Hz, 270 = $010e
.byte $01	; 43.653528929125486Hz, 286 = $011e
.byte $01	; 46.2493028389543Hz, 303 = $012f
.byte $01	; 48.999429497718666Hz, 321 = $0141
.byte $01	; 51.91308719749314Hz, 340 = $0154
.byte $01	; 55Hz, 360 = $0168
.byte $01	; 58.27047018976124Hz, 382 = $017e
.byte $01	; 61.7354126570155Hz, 405 = $0195
.byte $01	; 65.40639132514966Hz, 429 = $01ad
.byte $01	; 69.29565774421802Hz, 454 = $01c6
.byte $01	; 73.41619197935188Hz, 481 = $01e1
.byte $01	; 77.78174593052023Hz, 510 = $01fe
.byte $02	; 82.4068892282175Hz, 540 = $021c
.byte $02	; 87.30705785825097Hz, 572 = $023c
.byte $02	; 92.4986056779086Hz, 606 = $025e
.byte $02	; 97.99885899543733Hz, 642 = $0282
.byte $02	; 103.82617439498628Hz, 680 = $02a8
.byte $02	; 110Hz, 721 = $02d1
.byte $02	; 116.54094037952248Hz, 764 = $02fc
.byte $03	; 123.47082531403103Hz, 809 = $0329
.byte $03	; 130.8127826502993Hz, 857 = $0359
.byte $03	; 138.59131548843604Hz, 908 = $038c
.byte $03	; 146.8323839587038Hz, 962 = $03c2
.byte $03	; 155.56349186104046Hz, 1020 = $03fc
.byte $04	; 164.81377845643496Hz, 1080 = $0438
.byte $04	; 174.61411571650194Hz, 1144 = $0478
.byte $04	; 184.9972113558172Hz, 1212 = $04bc
.byte $05	; 195.99771799087463Hz, 1284 = $0504
.byte $05	; 207.65234878997256Hz, 1361 = $0551
.byte $05	; 220Hz, 1442 = $05a2
.byte $05	; 233.08188075904496Hz, 1528 = $05f8
.byte $06	; 246.94165062806206Hz, 1618 = $0652
.byte $06	; 261.6255653005986Hz, 1715 = $06b3
.byte $07	; 277.1826309768721Hz, 1817 = $0719
.byte $07	; 293.6647679174076Hz, 1925 = $0785
.byte $07	; 311.1269837220809Hz, 2039 = $07f7
.byte $08	; 329.6275569128699Hz, 2160 = $0870
.byte $08	; 349.2282314330039Hz, 2289 = $08f1
.byte $09	; 369.9944227116344Hz, 2425 = $0979
.byte $0a	; 391.99543598174927Hz, 2569 = $0a09
.byte $0a	; 415.3046975799451Hz, 2722 = $0aa2
.byte $0b	; 440Hz, 2884 = $0b44
.byte $0b	; 466.1637615180899Hz, 3055 = $0bef
.byte $0c	; 493.8833012561241Hz, 3237 = $0ca5
.byte $0d	; 523.2511306011972Hz, 3429 = $0d65
.byte $0e	; 554.3652619537442Hz, 3633 = $0e31
.byte $0f	; 587.3295358348151Hz, 3849 = $0f09
.byte $0f	; 622.2539674441618Hz, 4078 = $0fee
.byte $10	; 659.2551138257398Hz, 4320 = $10e0
.byte $11	; 698.4564628660078Hz, 4577 = $11e1
.byte $12	; 739.9888454232688Hz, 4850 = $12f2
.byte $14	; 783.9908719634985Hz, 5138 = $1412
.byte $15	; 830.6093951598903Hz, 5443 = $1543
